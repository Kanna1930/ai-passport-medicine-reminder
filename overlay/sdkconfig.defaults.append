## overlay/sdkconfig.defaults.append
```kconfig
# Medicine Reminder v2: Chinese UI + BLUFI provisioning
CONFIG_LV_FONT_SOURCE_HAN_SANS_SC_16_CJK=y
CONFIG_BT_ENABLED=y
CONFIG_BT_NIMBLE_ENABLED=y
CONFIG_BT_NIMBLE_BLUFI_ENABLE=y
CONFIG_BT_NIMBLE_ROLE_CENTRAL=n
CONFIG_BT_NIMBLE_ROLE_PERIPHERAL=y
CONFIG_BT_NIMBLE_ROLE_BROADCASTER=y
CONFIG_BT_NIMBLE_ROLE_OBSERVER=n
CONFIG_BT_NIMBLE_MAX_CONNECTIONS=1
CONFIG_BT_NIMBLE_HOST_BASED_PRIVACY=n
CONFIG_BT_NIMBLE_NVS_PERSIST=n
CONFIG_MBEDTLS_HARDWARE_MPI=n
CONFIG_MBEDTLS_DHM_C=y
```
